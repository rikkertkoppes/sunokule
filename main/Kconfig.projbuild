## main/Kconfig.projbuild
```kconfig
menu "Suno Kule config"

config SK_DATA_PIN_0
    int "data pin segment 0"
    default 25
    help
        Data pin for segment 0

config SK_DATA_PIN_1
    int "data pin segment 1"
    default 26
    help
        Data pin for segment 1

config SK_DATA_PIN_2
    int "data pin segment 2"
    default 27
    help
        Data pin for segment 2        
    

config SK_NUM_LEDS_0
    int "num leds 0"
    default 10
    help
        Number of leds for segment 0
        
config SK_NUM_LEDS_1
    int "num leds 1"
    default 0
    help
        Number of leds for segment 1

config SK_NUM_LEDS_2
    int "num leds 2"
    default 0
    help
        Number of leds for segment 2   
        
config SK_WIFI_SSID
    string "ssid"
    help
        SSID of the WIFI network to connect to

config SK_WIFI_PASS
    string "password"
    help
        password of the WIFI network to connect to        
endmenu
```

## sdkconfig.defaults
```kconfig
CONFIG_HTTPD_WS_SUPPORT=y
CONFIG_ESP_HTTPS_SERVER_ENABLE=y
CONFIG_HTTPD_MAX_REQ_HDR_LEN=1024

# We want maximum speed for shader computation
CONFIG_ESP_DEFAULT_CPU_FREQ_MHZ_240=y
CONFIG_ESP_DEFAULT_CPU_FREQ_MHZ=240
CONFIG_ESP32_DEFAULT_CPU_FREQ_240=y
CONFIG_ESP32_DEFAULT_CPU_FREQ_MHZ=240

# Need to measure idle task invocations to prevent
# watchdog task triggering
CONFIG_FREERTOS_USE_IDLE_HOOK=y

# Put timer task above our (led strip) background task
CONFIG_FREERTOS_TIMER_TASK_PRIORITY=1
CONFIG_TIMER_TASK_PRIORITY=2

# Enable task CPU usage monitoring
CONFIG_FREERTOS_USE_TRACE_FACILITY=y
CONFIG_FREERTOS_USE_STATS_FORMATTING_FUNCTIONS=y
CONFIG_FREERTOS_VTASKLIST_INCLUDE_COREID=y
CONFIG_FREERTOS_GENERATE_RUN_TIME_STATS=y
CONFIG_FREERTOS_RUN_TIME_STATS_USING_ESP_TIMER=y
```
